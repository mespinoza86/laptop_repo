## tesis/buildroot_dma_05/buildroot-2018.05/package/dmaproxy/Config.in
```kconfig
config BR2_PACKAGE_DMAPROXY
        bool "dmaproxy"
        depends on BR2_LINUX_KERNEL
        help
                Linux Kernel Module Cheat.
```

## tesis/buildroot_dma_05/buildroot-2018.05/package/dmaproxy/src/Kconfig
```kconfig
config DMAPROXY
        tristate "IP: DMAPROXY drivrer"
        select DMAPROXY
        default m
        ---help---
          WireGuard is a secure, fast, and easy to use replacement for IPSec
          that uses modern cryptography and clever networking tricks. It's
          designed to be fairly general purpose and abstract enough to fit most
          use cases, while at the same time remaining extremely simple to
          configure. See www.wireguard.com for more info.

          It's safe to say Y or M here, as the driver is very lightweight and
          is only in use when an administrator chooses to add an interface.
```

## tesis/buildroot_dma_05/buildroot-2018.05/package/udmabufmaster/Config.in
```kconfig
config BR2_PACKAGE_UDMABUFMASTER
        bool "udmabufmaster"
        depends on BR2_LINUX_KERNEL
        help
                Linux Kernel Module Cheat.
```

## tesis/buildroot_dma_05/udmabuftest/Config.in
```kconfig
config BR2_PACKAGE_UDMABUFTEST
	bool "udmabuftest"
	help
		hello world mpi package
```

## tesis/others/dmaproxytestmpi/Config.in
```kconfig
config BR2_PACKAGE_DMAPROXYTESTMPI
	bool "dmaproxytestmpi"
	help
		hello world mpi package
```

## tesis/others/helloworldmpi/Config.in
```kconfig
config BR2_PACKAGE_HELLOWORLDMPI
	bool "helloworldmpi"
	help
		hello world mpi package
```
